## Kconfig.projbuild
```kconfig
menu "RMT WS Tools Configuration"

    config RMT_TOOLS_WEB_URI
        string "Connect page URI"
        default "/rmt"
        help
            WEB page URI to set ssid/pass.

    config RMT_TOOLS_WEB_WS_URI
        string "Connect ws URI"
        default "/rmt/ws"
        help
            WEB ws URI to set ssid/pass.

    config RMT_TOOLS_START_WS_SERVER
        bool "Start WS server"
        default y
        help
            Start new WS server, or only register_uri_handlers on existing WS server.

    if  RMT_TOOLS_START_WS_SERVER
        config RMT_TOOLS_WIFI_CONNECT
            bool "Connect wifi"
            default y
            help
                Connect wifi or use on existing connection.
    endif

    if  RMT_TOOLS_WIFI_CONNECT
        config RMT_TOOLS_WIFI_SSID
            string "wifi ssid"
            default "myssid"
            help
                wifi ssid
        config RMT_TOOLS_WIFI_PASS
            string "wifi password"
            default "mypass"
            help
                wifi password
    endif

endmenu
```
